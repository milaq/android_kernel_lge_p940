## arch/arm/mach-omap2/lge/iff/Kconfig
```kconfig
#
# LGE IFF
#

config MACH_LGE_IFF
	bool "LGE IFF board"
	select TWL6030_GPADC
	select INPUT_MISC
	select HWMON
	select OMAP_PACKAGE_CBL
	select OMAP_PACKAGE_CBS
	select REGULATOR_FIXED_VOLTAGE
	select OMAP_TPS6236X
	select TWL6030_POWEROFF
	select INPUT_TWL6030_PWRBUTTON
	select OMAP_REBOOT_REASON
```

## arch/arm/mach-omap2/lge/lghdk/Kconfig
```kconfig
#
# LGE HDK4460
#

config MACH_LGE_HDK
	bool "LGE HDK board"
	select TWL6030_GPADC
	select INPUT_MISC
	select HWMON
	select OMAP_PACKAGE_CBL
	select OMAP_PACKAGE_CBS
	select REGULATOR_FIXED_VOLTAGE
	select OMAP_TPS6236X
	select TWL6030_POWEROFF
	select INPUT_TWL6030_PWRBUTTON
	select OMAP_REBOOT_REASON
```

## drivers/lge/misc/Kconfig
```kconfig
config LGE_VIBRATOR
	bool "OMAP PWM Vibrator"
	default n
	help
	  Vibrator driver with OMAP-PWM

config SENSORS_APDS9900
	bool "Avago APDS9900 sensor"
	default n
    depends on MACH_LGE_P2
	help
	  If you say Y here you get support for the Avago APDS9900
	  ambient light + proximity sensor.

config SENSORS_APDS9900_LAZY_SENSOR_BLOB
	bool "Lazy APDS9900 userspace sensorlib"
	default n
    depends on SENSORS_APDS9900
	help
	  Say Y here if you want the Avago APDS9900 driver to 
	  report the luxvalues via polling rather than via interrupt.
	  This also includes a synthetic jitter applied to the values
	  in order to work around lazy sensorlibs which only pass
	  the luxvalues if they are at least one off from the prior
	  reading.

config BACKLIGHT_LM3528
	bool "Backlight Driver for LM3528"
	depends on BACKLIGHT_CLASS_DEVICE
	select SUBPMIC_LM3528
	help
	  If you have a LCD backlight connected to the MAIN and(or)
	  SUB/FB output of LM3528, say Y here to enable this driver.
	  To compile this driver as a module, choose M here: the module
	  will be called lm3528_bl

config BACKLIGHT_LM3530
	bool "Backlight Driver for LM3530"
	depends on BACKLIGHT_CLASS_DEVICE
	select SUBPMIC_LM3530
	help
	  If you have a LCD backlight connected to the MAIN and(or)
	  SUB/FB output of LM3530, say Y here to enable this driver.
	  To compile this driver as a module, choose M here: the module
	  will be called lm3530_bl

config BACKLIGHT_LM3533
	bool "Backlight Driver for LM3530"
	depends on BACKLIGHT_CLASS_DEVICE
	select SUBPMIC_LM3533
	help
	  If you have a LCD backlight connected to the MAIN and(or)
	  SUB/FB output of LM3533, say Y here to enable this driver.
	  To compile this driver as a module, choose M here: the module
	  will be called lm3533_bl

config CAMERAFLASH_LM3559
	bool "Camera flash driver for LM3559"
	default n
	help
	  This is a camera flash driver for LM3559

config KEYPAD_LEDS_GPIO
	bool "Keypad led driver controlled by GPIO"
	select NEW_LEDS
	select LEDS_CLASS
	help
	  If you say Y here get driver support for the keypad backlight
	  controlled by GPIO

config LGE_GPIO_CONTROL
	bool "GPIO control support"
	default n
	help
	  If you want to change GPIO control, say Y
```
